## zadanie_4/meta-iot-bsp/files/wic/iot-qemuarm64-ab.wks
```
# Układ A/B + rescue (zadanie 6). Numery partycji używa boot.scr.
part --source bootimg-partition --fstype=vfat --label boot --align 1024 --size 64M
part / --source rootfs --fstype=ext4 --label rootfsA --align 1024 --fixed-size 1024M --use-uuid
part --source rootfs --fstype=ext4 --label rootfsB --align 1024 --fixed-size 1024M --use-uuid
part --fstype=ext4 --label rescue --align 1024 --size 256M --use-uuid
part --label data --align 1024 --size 256M --use-uuid
part --fstype=ext4 --label persist --align 1024 --size 32M --use-uuid
bootloader --ptable gpt
```
